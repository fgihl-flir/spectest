## CMakeLists.txt
```
# SPDX-License-Identifier: Apache-2.0

cmake_minimum_required(VERSION 3.20.0)

find_package(Zephyr REQUIRED HINTS $ENV{ZEPHYR_BASE})
project(hello_world_shell)

target_sources(app PRIVATE src/main.c)
```

## sample.yaml
```
sample:
  name: Hello World Shell
  description: A simple hello world application with shell support
common:
  tags: shell console
  integration_platforms:
    - native_posix
    - qemu_x86
  harness: console
  harness_config:
    type: one_line
    regex:
      - "Hello World!"
```

## west.yml
```
# west.yml for spectest - A Zephyr 4.2 freestanding application
manifest:
  version: "0.13"

  # Define the remote repositories
  remotes:
    - name: zephyrproject-rtos
      url-base: https://github.com/zephyrproject-rtos

  # Define the projects to include
  projects:
    - name: zephyr
      remote: zephyrproject-rtos
      revision: v4.2.0
      import: true

  # Mark this repository as the application
  self:
    path: spectest
```

## prj.conf
```kconfig
# Enable console
CONFIG_CONSOLE=y
CONFIG_UART_CONSOLE=y

# Enable shell
CONFIG_SHELL=y
CONFIG_SHELL_BACKEND_SERIAL=y

# Increase stack sizes for shell
CONFIG_MAIN_STACK_SIZE=2048
CONFIG_SHELL_STACK_SIZE=2048
```

## src/main.c
```c
/*
 * Copyright (c) 2025
 * SPDX-License-Identifier: Apache-2.0
 */

#include <zephyr/kernel.h>
#include <zephyr/shell/shell.h>
#include <zephyr/logging/log.h>

LOG_MODULE_REGISTER(hello_world, LOG_LEVEL_INF);

/**
 * @brief Shell command handler for "hello" command
 * 
 * This function is called when the "hello" command is entered in the shell.
 * It prints "world" as the response.
 */
static int cmd_hello(const struct shell *sh, size_t argc, char **argv)
{
	ARG_UNUSED(argc);
	ARG_UNUSED(argv);

	shell_print(sh, "world");
	return 0;
}

/* Register the "hello" command with the shell */
SHELL_CMD_REGISTER(hello, NULL, "Print 'world'", cmd_hello);

int main(void)
{
	printk("Hello World! %s\n", CONFIG_BOARD);
	LOG_INF("Application started");
	
	return 0;
}
```
